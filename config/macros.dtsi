#include "zmk-helpers/helper.h"

ZMK_BEHAVIOR(macro_grave, macro, \
    compatible = "zmk,behavior-macro"; \
    label = "macro_grave"; \
    #binding-cells = <0>; \
    bindings = <&kp GRAVE>, <&kp GRAVE>, <&kp LEFT>; \
)

ZMK_BEHAVIOR(macro_arrows, macro, \
    compatible = "zmk,behavior-macro"; \
    label = "macro_arrows"; \
    #binding-cells = <0>; \
    bindings = <&kp LESS_THAN>, <&kp GREATER_THAN>, <&kp LEFT>; \
)

ZMK_BEHAVIOR(macro_quotes, macro, \
    compatible = "zmk,behavior-macro"; \
    label = "macro_quotes"; \
    #binding-cells = <0>; \
    bindings = <&kp SQT>, <&kp SQT>, <&kp LEFT>; \
)

ZMK_BEHAVIOR(macro_dquotes, macro, \
    compatible = "zmk,behavior-macro"; \
    label = "macro_dquotes"; \
    #binding-cells = <0>; \
    bindings = <&kp DQT>, <&kp DQT>, <&kp LEFT>; \
)

ZMK_BEHAVIOR(macro_braces, macro, \
    compatible = "zmk,behavior-macro"; \
    label = "macro_braces"; \
    #binding-cells = <0>; \
    bindings = <&kp LBRC>, <&kp RBRC>, <&kp LEFT>; \
)

ZMK_BEHAVIOR(macro_parens, macro, \
    compatible = "zmk,behavior-macro"; \
    label = "macro_parens"; \
    #binding-cells = <0>; \
    bindings = <&kp LPAR>, <&kp RPAR>, <&kp LEFT>; \
)

ZMK_BEHAVIOR(macro_brackets, macro, \
    compatible = "zmk,behavior-macro"; \
    label = "macro_brackets"; \
    #binding-cells = <0>; \
    bindings = <&kp LBKT>, <&kp RBKT>, <&kp LEFT>; \
)

/* vim: set ft=c tw=174: */

